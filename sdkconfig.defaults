## sdkconfig.defaults
```kconfig
# Flash
CONFIG_ESPTOOLPY_FLASHSIZE_4MB=y

# UART
CONFIG_ESP_CONSOLE_USB_SERIAL_JTAG=y

# HTTPD
CONFIG_HTTPD_MAX_REQ_HDR_LEN=1024
CONFIG_HTTPD_MAX_URI_LEN=512
CONFIG_HTTPD_WS_SUPPORT=y

# Increase main task stack
CONFIG_ESP_MAIN_TASK_STACK_SIZE=8192

# Log level
CONFIG_LOG_DEFAULT_LEVEL_INFO=y

# OTA
CONFIG_BOOTLOADER_APP_ROLLBACK_ENABLE=y
```

## src/Kconfig.projbuild
```kconfig
menu "MR60BHA2 Radar"

    config WIFI_SSID
        string "WiFi SSID"
        default ""
        help
            SSID (network name) of your WiFi network.

    config WIFI_PASS
        string "WiFi Password"
        default ""
        help
            Password for your WiFi network.
            Note: if your password contains special characters like '#', set it
            via environment variable instead:
              idf.py -DCONFIG_WIFI_PASS='your#pass' build

endmenu
```
